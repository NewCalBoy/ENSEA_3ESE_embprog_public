#include "display.h"

#include <string.h>

#define OLED_SCALE    4
#define OLED_ORIGIN_X 30
#define OLED_ORIGIN_Y 68

typedef struct {
    char ch;
    const char *rows[7]; /* '#' = pixel allume, sinon pixel eteint */
} font_glyph_t;

static const font_glyph_t FONT[] = {
    {' ', {".....", ".....", ".....", ".....", ".....", ".....", "....."}},
    {':', {".....", "..#..", ".....", ".....", ".....", "..#..", "....."}},
    {'.', {".....", ".....", ".....", ".....", ".....", ".....", "..#.."}},
    {'-', {".....", ".....", ".....", "#####", ".....", ".....", "....."}},
    {'+', {".....", "..#..", "..#..", "#####", "..#..", "..#..", "....."}},
    {'_', {".....", ".....", ".....", ".....", ".....", ".....", "#####"}},
    {'*', {".....", "#.#.#", ".###.", "#####", ".###.", "#.#.#", "....."}},
    {'%', {"#...#", "....#", "...#.", "..#..", ".#...", "#....", "#...#"}},
    {'>', {"#....", ".#...", "..#..", "...#.", "..#..", ".#...", "#...."}},
    {'<', {"....#", "...#.", "..#..", ".#...", "..#..", "...#.", "....#"}},
    {'/', {"....#", "...#.", "...#.", "..#..", ".#...", ".#...", "#...."}},
    {'0', {".###.", "#...#", "#..##", "#.#.#", "##..#", "#...#", ".###."}},
    {'1', {"..#..", ".##..", "..#..", "..#..", "..#..", "..#..", ".###."}},
    {'2', {".###.", "#...#", "....#", "...#.", "..#..", ".#...", "#####"}},
    {'3', {".###.", "#...#", "....#", "..##.", "....#", "#...#", ".###."}},
    {'4', {"...#.", "..##.", ".#.#.", "#..#.", "#####", "...#.", "...#."}},
    {'5', {"#####", "#....", "####.", "....#", "....#", "#...#", ".###."}},
    {'6', {".###.", "#....", "#....", "####.", "#...#", "#...#", ".###."}},
    {'7', {"#####", "....#", "...#.", "..#..", ".#...", ".#...", ".#..."}},
    {'8', {".###.", "#...#", "#...#", ".###.", "#...#", "#...#", ".###."}},
    {'9', {".###.", "#...#", "#...#", ".####", "....#", "....#", ".###."}},
    {'A', {".###.", "#...#", "#...#", "#####", "#...#", "#...#", "#...#"}},
    {'B', {"####.", "#...#", "#...#", "####.", "#...#", "#...#", "####."}},
    {'C', {".####", "#....", "#....", "#....", "#....", "#....", ".####"}},
    {'D', {"####.", "#...#", "#...#", "#...#", "#...#", "#...#", "####."}},
    {'E', {"#####", "#....", "#....", "####.", "#....", "#....", "#####"}},
    {'F', {"#####", "#....", "#....", "####.", "#....", "#....", "#...."}},
    {'G', {".####", "#....", "#....", "#.###", "#...#", "#...#", ".####"}},
    {'H', {"#...#", "#...#", "#...#", "#####", "#...#", "#...#", "#...#"}},
    {'I', {"#####", "..#..", "..#..", "..#..", "..#..", "..#..", "#####"}},
    {'J', {"..###", "...#.", "...#.", "...#.", "...#.", "#..#.", ".##.."}},
    {'K', {"#...#", "#..#.", "#.#..", "##...", "#.#..", "#..#.", "#...#"}},
    {'L', {"#....", "#....", "#....", "#....", "#....", "#....", "#####"}},
    {'M', {"#...#", "##.##", "#.#.#", "#...#", "#...#", "#...#", "#...#"}},
    {'N', {"#...#", "##..#", "#.#.#", "#..##", "#...#", "#...#", "#...#"}},
    {'O', {".###.", "#...#", "#...#", "#...#", "#...#", "#...#", ".###."}},
    {'P', {"####.", "#...#", "#...#", "####.", "#....", "#....", "#...."}},
    {'Q', {".###.", "#...#", "#...#", "#...#", "#.#.#", "#..#.", ".##.#"}},
    {'R', {"####.", "#...#", "#...#", "####.", "#.#..", "#..#.", "#...#"}},
    {'S', {".####", "#....", "#....", ".###.", "....#", "....#", "####."}},
    {'T', {"#####", "..#..", "..#..", "..#..", "..#..", "..#..", "..#.."}},
    {'U', {"#...#", "#...#", "#...#", "#...#", "#...#", "#...#", ".###."}},
    {'V', {"#...#", "#...#", "#...#", "#...#", "#...#", ".#.#.", "..#.."}},
    {'W', {"#...#", "#...#", "#...#", "#.#.#", "#.#.#", "##.##", "#...#"}},
    {'X', {"#...#", "#...#", ".#.#.", "..#..", ".#.#.", "#...#", "#...#"}},
    {'Y', {"#...#", "#...#", ".#.#.", "..#..", "..#..", "..#..", "..#.."}},
    {'Z', {"#####", "....#", "...#.", "..#..", ".#...", "#....", "#####"}},
};
#define FONT_COUNT (sizeof(FONT) / sizeof(FONT[0]))

static const font_glyph_t *font_find(char c) {
    for (size_t i = 0; i < FONT_COUNT; i++) {
        if (FONT[i].ch == c) {
            return &FONT[i];
        }
    }
    return &FONT[0]; /* caractere inconnu -> espace */
}

static void set_pixel(bsp_display_t *disp, int x, int y, bool on) {
    if (x >= 0 && x < BSP_OLED_WIDTH && y >= 0 && y < BSP_OLED_HEIGHT) {
        disp->pixels[y][x] = on;
    }
}

void bsp_display_init(bsp_display_t *disp) {
    bsp_display_clear(disp);
}

void bsp_display_clear(bsp_display_t *disp) {
    memset(disp->pixels, 0, sizeof(disp->pixels));
}

void bsp_display_fill(bsp_display_t *disp, int x, int y, int w, int h, bool on) {
    for (int row = 0; row < h; row++) {
        for (int col = 0; col < w; col++) {
            set_pixel(disp, x + col, y + row, on);
        }
    }
}

void bsp_display_text(bsp_display_t *disp, int x, int y, const char *str, bool on) {
    int cursor_x = x;
    for (const char *c = str; *c != '\0'; c++) {
        const font_glyph_t *glyph = font_find(*c);
        for (int row = 0; row < 7; row++) {
            for (int col = 0; col < 5; col++) {
                if (glyph->rows[row][col] == '#') {
                    set_pixel(disp, cursor_x + col, y + row, on);
                }
            }
        }
        cursor_x += 6; /* 5 px de glyphe + 1 px d'espacement */
    }
}

void bsp_display_render(const bsp_display_t *disp, SDL_Renderer *renderer) {
    SDL_FRect frame = {OLED_ORIGIN_X - 4, OLED_ORIGIN_Y - 4,
                        BSP_OLED_WIDTH * OLED_SCALE + 8, BSP_OLED_HEIGHT * OLED_SCALE + 8};
    SDL_SetRenderDrawColor(renderer, 90, 90, 95, 255);
    SDL_RenderFillRect(renderer, &frame);

    SDL_FRect bg = {OLED_ORIGIN_X, OLED_ORIGIN_Y, BSP_OLED_WIDTH * OLED_SCALE, BSP_OLED_HEIGHT * OLED_SCALE};
    SDL_SetRenderDrawColor(renderer, 5, 5, 8, 255);
    SDL_RenderFillRect(renderer, &bg);

    SDL_SetRenderDrawColor(renderer, 225, 235, 245, 255);
    for (int y = 0; y < BSP_OLED_HEIGHT; y++) {
        for (int x = 0; x < BSP_OLED_WIDTH; x++) {
            if (disp->pixels[y][x]) {
                SDL_FRect px = {OLED_ORIGIN_X + x * OLED_SCALE, OLED_ORIGIN_Y + y * OLED_SCALE,
                                 OLED_SCALE, OLED_SCALE};
                SDL_RenderFillRect(renderer, &px);
            }
        }
    }
}
